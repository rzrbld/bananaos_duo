## overlay/buildroot/configs/banana_duolite_defconfig
```kconfig
BR2_aarch64=y
BR2_cortex_a73=y
BR2_BANANA_DUOLITE=y
BR2_OPTIMIZE_2=y
BR2_JLEVEL=12
BR2_GLOBAL_PATCH_DIR="$(BR2_EXTERNAL_BANANA_PATH)/patches"
BR2_TOOLCHAIN_EXTERNAL=y
BR2_TOOLCHAIN_EXTERNAL_BOOTLIN=y
BR2_TOOLCHAIN_EXTERNAL_BOOTLIN_AARCH64_GLIBC_STABLE=y
BR2_TOOLCHAIN_GLIBC_GCONV_LIBS_COPY=y
BR2_TOOLCHAIN_GLIBC_GCONV_LIBS_LIST="UTF-16 UNICODE"
BR2_CCACHE=y
# BR2_DOWNLOAD_FORCE_CHECK_HASHES is not set
BR2_TARGET_ENABLE_ROOT_LOGIN=y
BR2_TARGET_GENERIC_ROOT_PASSWD="rocknix"
BR2_TARGET_GENERIC_HOSTNAME="banana"
BR2_TARGET_GENERIC_ISSUE="BananaOS Duo Lite bring-up"
BR2_INIT_BUSYBOX=y
BR2_PACKAGE_BUSYBOX_CONFIG_FRAGMENT_FILES="$(BR2_EXTERNAL_BANANA_PATH)/board/rgds/busybox.fragment"
BR2_ROOTFS_DEVICE_CREATION_DYNAMIC_EUDEV=y
# BR2_TARGET_GENERIC_GETTY is not set
# BR2_TARGET_GENERIC_REMOUNT_ROOTFS_RW is not set
BR2_ROOTFS_OVERLAY="$(BR2_EXTERNAL_BANANA_PATH)/../system/rootfs $(BR2_EXTERNAL_BANANA_PATH)/board/duolite/rootfs"
BR2_ROOTFS_POST_BUILD_SCRIPT="$(BR2_EXTERNAL_BANANA_PATH)/board/duolite/post-build.sh"
BR2_ROOTFS_POST_IMAGE_SCRIPT="$(BR2_EXTERNAL_BANANA_PATH)/board/duolite/post-image.sh"
BR2_LINUX_KERNEL=y
BR2_LINUX_KERNEL_CUSTOM_TARBALL=y
BR2_LINUX_KERNEL_CUSTOM_TARBALL_LOCATION="https://www.kernel.org/pub/linux/kernel/v7.x/linux-7.3.5.tar.xz"
BR2_LINUX_KERNEL_USE_CUSTOM_CONFIG=y
BR2_LINUX_KERNEL_CUSTOM_CONFIG_FILE="$(BR2_EXTERNAL_BANANA_PATH)/board/duolite/linux-rocknix.config"
BR2_LINUX_KERNEL_CONFIG_FRAGMENT_FILES="$(BR2_EXTERNAL_BANANA_PATH)/board/duolite/linux-banana.fragment"
BR2_LINUX_KERNEL_DTS_SUPPORT=y
BR2_LINUX_KERNEL_INTREE_DTS_NAME="qcom/sm6125-retroid-pocket-duo-lite"
BR2_LINUX_KERNEL_NEEDS_HOST_OPENSSL=y
BR2_LINUX_KERNEL_NEEDS_HOST_LIBELF=y
BR2_TARGET_ROOTFS_SQUASHFS=y
BR2_TARGET_ROOTFS_SQUASHFS4_LZ4=y
# BR2_TARGET_ROOTFS_TAR is not set
BR2_PACKAGE_HOST_GENIMAGE=y
BR2_PACKAGE_HOST_DOSFSTOOLS=y
BR2_PACKAGE_HOST_MTOOLS=y
BR2_PACKAGE_ROCKNIX_EXTRA_FIRMWARE=y
BR2_PACKAGE_WIRELESS_REGDB=y
BR2_PACKAGE_IW=y
BR2_PACKAGE_BANANA_UI=y
BR2_PACKAGE_BANANAD=y
BR2_PACKAGE_BANANADS=y
BR2_PACKAGE_ALSA_LIB=y
BR2_PACKAGE_ALSA_UTILS=y
BR2_PACKAGE_ALSA_UTILS_AMIXER=y
BR2_PACKAGE_ALSA_UTILS_ALSACTL=y
BR2_PACKAGE_ALSA_UTILS_ALSAUCM=y
BR2_PACKAGE_ALSA_UTILS_APLAY=y
BR2_PACKAGE_ALSA_UCM_CONF=y
BR2_PACKAGE_FREETYPE=y
BR2_PACKAGE_LIBDRM=y
BR2_PACKAGE_MESA3D_ADRENO=y
BR2_PACKAGE_VULKAN_TOOLS=y
BR2_PACKAGE_LIBCURL=y
BR2_PACKAGE_LIBCURL_CURL=y
BR2_PACKAGE_LIBCURL_OPENSSL=y
BR2_PACKAGE_LIBSSH2=y
BR2_PACKAGE_LIBSSH2_OPENSSL=y
BR2_PACKAGE_LIBSMB2=y
BR2_PACKAGE_SEVENZIP=y
BR2_PACKAGE_ZLIB=y
BR2_PACKAGE_EXFATPROGS=y
BR2_PACKAGE_UTIL_LINUX=y
BR2_PACKAGE_UTIL_LINUX_BINARIES=y
BR2_PACKAGE_UTIL_LINUX_PARTX=y
BR2_PACKAGE_KMOD=y
BR2_PACKAGE_KMOD_TOOLS=y
BR2_PACKAGE_WPA_SUPPLICANT=y
BR2_PACKAGE_WPA_SUPPLICANT_WPA3=y
BR2_PACKAGE_WPA_SUPPLICANT_CLI=y
BR2_PACKAGE_WPA_SUPPLICANT_AUTOSCAN=y
BR2_PACKAGE_DROPBEAR=y
# BR2_PACKAGE_DROPBEAR_CLIENT is not set
BR2_PACKAGE_DROPBEAR_DISABLE_REVERSEDNS=y
BR2_PACKAGE_CA_CERTIFICATES=y
BR2_PACKAGE_BUSYBOX_SHOW_OTHERS=y
BR2_PACKAGE_BASH=y
BR2_PACKAGE_PYTHON3=y
BR2_PACKAGE_PYTHON3_PYC_ONLY=y
BR2_PACKAGE_PYTHON3_ZLIB=y
BR2_PACKAGE_PYTHON3_XZ=y
BR2_PACKAGE_PYTHON3_BZIP2=y
BR2_PACKAGE_SDL2_KMSDRM=y
BR2_PACKAGE_SDL2_OPENGLES=y
BR2_PACKAGE_SDL2_IMAGE=y
BR2_PACKAGE_LIBPNG=y
BR2_PACKAGE_JPEG=y
BR2_PACKAGE_SDL2_TTF=y
BR2_PACKAGE_SDL2_MIXER=y

BR2_PACKAGE_QCOM_QRTR=y
BR2_PACKAGE_QCOM_TQFTPSERV=y
BR2_PACKAGE_QCOM_RMTFS=y

# Store and Doda Kvarter use the Duo Lite platform patch.
BR2_PACKAGE_DODAKVARTER=y
# BR2_PACKAGE_MAME_GNW is not set
# BR2_PACKAGE_ROCKNIXDS_STORE is not set
BR2_PACKAGE_SLOPETANIUM=y

BR2_PACKAGE_QCOM_ADRENO_FIRMWARE=y

# Bluetooth controllers, LE HID, and A2DP audio (same stack as BananaOS RG DS).
BR2_PACKAGE_BLUEZ5_UTILS=y
BR2_PACKAGE_BLUEZ5_UTILS_CLIENT=y
BR2_PACKAGE_BLUEZ5_UTILS_PLUGINS_HID=y
BR2_PACKAGE_BLUEZ5_UTILS_PLUGINS_HOG=y
BR2_PACKAGE_BLUEZ5_UTILS_MONITOR=y
BR2_PACKAGE_BLUEZ_ALSA=y
BR2_PACKAGE_LIBOPENAPTX=y
BR2_PACKAGE_LDACBT=y

# Native PortMaster runtimes (LÖVE11.5 and bundled libretro ports).
BR2_PACKAGE_OPENAL=y
BR2_PACKAGE_LIBVORBIS=y
BR2_PACKAGE_LIBTHEORA=y
BR2_PACKAGE_MPG123=y
BR2_PACKAGE_RETROARCH=y
BR2_PACKAGE_LIBRETRO_GPSP=y
BR2_PACKAGE_LIBRETRO_MGBA=y
# BR2_PACKAGE_LIBRETRO_BANANAGBA is not set
BR2_PACKAGE_LIBRETRO_GAMBATTE=y
BR2_PACKAGE_LIBRETRO_FCEUMM=y
BR2_PACKAGE_LIBRETRO_BANANANES=y
BR2_PACKAGE_LIBRETRO_SNES9X=y
# BR2_PACKAGE_LIBRETRO_BANANASNES is not set
BR2_PACKAGE_LIBRETRO_PICODRIVE=y
BR2_PACKAGE_LIBRETRO_VICE=y
BR2_PACKAGE_LIBRETRO_FUSE=y
BR2_PACKAGE_LIBRETRO_PCSX_REARMED=y
BR2_PACKAGE_LIBRETRO_MUPEN64PLUS_NEXT=y
BR2_PACKAGE_LIBRETRO_FAKE08=y
# BR2_PACKAGE_LIBRETRO_CHEATS_NDS is not set

# Match upstream BananaLinux's non-hardware runtime dependencies.
BR2_PACKAGE_PYTHON3_PYEXPAT=y
BR2_PACKAGE_PYTHON3_SSL=y
BR2_PACKAGE_PYTHON3_SQLITE=y
BR2_PACKAGE_PYTHON3_UNICODEDATA=y
BR2_PACKAGE_KSMBD_TOOLS=y

# Additional native console, arcade and computer cores.
BR2_PACKAGE_LIBRETRO_GENESIS_PLUS_GX=y
BR2_PACKAGE_LIBRETRO_CAP32=y
BR2_PACKAGE_LIBRETRO_MAME2003_PLUS=y
BR2_PACKAGE_LIBRETRO_PPSSPP=y
BR2_PACKAGE_LIBRETRO_FLYCAST=y
BR2_PACKAGE_LIBRETRO_DOLPHIN=y
BR2_PACKAGE_LIBRETRO_CITRA=y
```

## overlay/buildroot/package/mesa3d-adreno/Config.in
```kconfig
config BR2_PACKAGE_MESA3D_ADRENO
	bool "Mesa Freedreno and Turnip"
	depends on BR2_aarch64
	depends on !BR2_PACKAGE_MESA3D && !BR2_PACKAGE_MESA3D_PANFROST
	depends on BR2_INSTALL_LIBSTDCPP && !BR2_STATIC_LIBS
	depends on BR2_TOOLCHAIN_HAS_THREADS_NPTL
	select BR2_PACKAGE_LIBDRM
	select BR2_PACKAGE_LIBDRM_FREEDRENO
	select BR2_PACKAGE_EXPAT
	select BR2_PACKAGE_ZLIB
	select BR2_PACKAGE_VULKAN_LOADER
	select BR2_PACKAGE_HAS_LIBEGL
	select BR2_PACKAGE_HAS_LIBGLES
	select BR2_PACKAGE_HAS_LIBGBM
	select BR2_PACKAGE_LIBGBM_HAS_FEATURE_FORMAT_MODIFIER_PLANE_COUNT
	select BR2_PACKAGE_LIBGBM_HAS_FEATURE_DMA_BUF

if BR2_PACKAGE_MESA3D_ADRENO
config BR2_PACKAGE_MESA3D_ADRENO_DESKTOP
	bool "X11 window-system support"
	depends on BR2_PACKAGE_XORG7
	select BR2_PACKAGE_XLIB_LIBX11
	select BR2_PACKAGE_XLIB_LIBXEXT
	select BR2_PACKAGE_XLIB_LIBXDAMAGE
	select BR2_PACKAGE_XLIB_LIBXFIXES
	select BR2_PACKAGE_XLIB_LIBXRANDR
	select BR2_PACKAGE_XLIB_LIBXXF86VM
	select BR2_PACKAGE_XLIB_LIBXSHMFENCE
	select BR2_PACKAGE_LIBXCB
	select BR2_PACKAGE_XORGPROTO
	select BR2_PACKAGE_HAS_LIBGL
	help
	  Native Freedreno GLX/EGL and Turnip WSI for independently installed
	  desktop applications. Does not install an X server or desktop shell.

config BR2_PACKAGE_PROVIDES_LIBGL
	default "mesa3d-adreno" if BR2_PACKAGE_MESA3D_ADRENO_DESKTOP
config BR2_PACKAGE_PROVIDES_LIBEGL
	default "mesa3d-adreno"
config BR2_PACKAGE_PROVIDES_LIBGLES
	default "mesa3d-adreno"
config BR2_PACKAGE_PROVIDES_LIBGBM
	default "mesa3d-adreno"
endif
```

## overlay/buildroot/package/qcom-adreno-firmware/Config.in
```kconfig
config BR2_PACKAGE_QCOM_ADRENO_FIRMWARE
	bool "Adreno 610 GPU microcode"
	depends on BR2_BANANA_DUOLITE
```

## overlay/buildroot/package/qcom-qrtr/Config.in
```kconfig
config BR2_PACKAGE_QCOM_QRTR
	bool "Qualcomm qrtr"
	depends on BR2_BANANA_DUOLITE
```

## overlay/buildroot/package/qcom-rmtfs/Config.in
```kconfig
config BR2_PACKAGE_QCOM_RMTFS
	bool "Qualcomm remote filesystem service"
	depends on BR2_BANANA_DUOLITE
	depends on BR2_PACKAGE_HAS_UDEV
	select BR2_PACKAGE_QCOM_QRTR
```

## overlay/buildroot/package/qcom-tqftpserv/Config.in
```kconfig
config BR2_PACKAGE_QCOM_TQFTPSERV
	bool "Qualcomm tqftpserv"
	depends on BR2_BANANA_DUOLITE
	select BR2_PACKAGE_QCOM_QRTR
	select BR2_PACKAGE_ZSTD
```

## overlay/buildroot/package/slopetanium/Config.in
```kconfig
config BR2_PACKAGE_SLOPETANIUM
	bool "Slopetanium app and port manager"
	select BR2_PACKAGE_SDL2
	select BR2_PACKAGE_FREETYPE
	select BR2_PACKAGE_PYTHON3
	select BR2_PACKAGE_PYTHON3_SSL
	select BR2_PACKAGE_PYTHON3_ZLIB
	select BR2_PACKAGE_PYTHON3_PYEXPAT
	select BR2_PACKAGE_CA_CERTIFICATES
	help
	  Native dual-panel manager. Apps appear on the BananaOS home menu;
	  PortMaster packages use its original installer and Ports directory.
```

## overlay/buildroot/package/venus-vaapi/Config.in
```kconfig
config BR2_PACKAGE_VENUS_VAAPI
	bool "Venus stateful V4L2 VA-API backend"
	depends on BR2_BANANA_DUOLITE
	depends on BR2_INSTALL_LIBSTDCPP
	depends on BR2_TOOLCHAIN_HAS_THREADS
	depends on !BR2_STATIC_LIBS
	select BR2_PACKAGE_LIBVA
	help
	  VA-API bridge for the Qualcomm Venus V4L2 decoder. Graphics
	  composition continues to use the OS Freedreno/Turnip drivers.
```
